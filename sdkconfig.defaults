## sdkconfig.defaults
```kconfig
# SenseCAP Watcher - ESP32-S3 SDK Config Defaults

# Target chip
CONFIG_IDF_TARGET="esp32s3"

# CPU
CONFIG_ESP32S3_DEFAULT_CPU_FREQ_240=y

# PSRAM - 8MB Octal SPI
CONFIG_SPIRAM=y
CONFIG_SPIRAM_MODE_OCT=y
CONFIG_SPIRAM_SPEED_80M=y
CONFIG_SPIRAM_BOOT_INIT=y

# Flash - 32MB QIO
CONFIG_ESPTOOLPY_FLASHSIZE_32MB=y
CONFIG_ESPTOOLPY_FLASHFREQ_80M=y
CONFIG_ESPTOOLPY_FLASHMODE_QIO=y

# Partition table
CONFIG_PARTITION_TABLE_CUSTOM=y
CONFIG_PARTITION_TABLE_CUSTOM_FILENAME="partitions.csv"

# WiFi
CONFIG_ESP_WIFI_ENABLED=y

# Bluetooth
CONFIG_BT_ENABLED=y
CONFIG_BT_NIMBLE_ENABLED=y

# Console via UART (CH344 USB-UART bridge on ttyACM2)
CONFIG_ESP_CONSOLE_UART_DEFAULT=y

# LVGL
CONFIG_LV_COLOR_16_SWAP=y
CONFIG_LV_FONT_MONTSERRAT_14=y
CONFIG_LV_FONT_MONTSERRAT_20=y
CONFIG_LV_MEMCPY_MEMSET_STD=y

# TLS — disable hardware RSA to avoid interrupt exhaustion
# (WiFi + I2S + SPI LCD + I2C touch + I2C audio + LEDC + RMT use all slots)
CONFIG_MBEDTLS_HARDWARE_MPI=n

# TLS — external (PSRAM) allocation so concurrent TLS connections can coexist
# (stream-player + stream-recorder WebSockets both need TLS simultaneously;
# each TLS context uses ~15 KB — too much for the ~64 KB internal SRAM budget)
CONFIG_MBEDTLS_EXTERNAL_MEM_ALLOC=y
CONFIG_MBEDTLS_ASYMMETRIC_CONTENT_LEN=y
CONFIG_MBEDTLS_SSL_IN_CONTENT_LEN=16384
CONFIG_MBEDTLS_SSL_OUT_CONTENT_LEN=4096
CONFIG_MBEDTLS_DYNAMIC_BUFFER=y
CONFIG_MBEDTLS_DYNAMIC_FREE_PEER_CERT=y
CONFIG_MBEDTLS_DYNAMIC_FREE_CONFIG_DATA=y
# Software AES — hardware AES needs DMA-capable (internal) memory which is scarce
CONFIG_MBEDTLS_HARDWARE_AES=n

# Allow FreeRTOS task stacks to be placed in PSRAM
CONFIG_SPIRAM_ALLOW_STACK_EXTERNAL_MEMORY=y

# Logging
CONFIG_LOG_DEFAULT_LEVEL_INFO=y
CONFIG_LOG_MAXIMUM_LEVEL_DEBUG=y
```
